#include "defs.dtsi"
#include "undef_rows.dtsi"

#define LEFT_TOP_0    &kp EQUAL  &kp MINUS   &kp MINUS    &kp LPAR     &kp LBRC      &kp LBKT  &tog NUMBER_LAYER
#define LEFT_UPPER_0  &kp LGUI   &kp SQT     &kp COMMA    &lt 1 DOT    &kp P         &kp Y     &none
#define LEFT_MIDDLE_0 &kp LALT   &hm LGUI A  &hm LALT O   &hm LCTRL E  &hm LSHIFT U  &lt 2 I   &none               &mo 2      &kp LSHFT
#define LEFT_LOWER_0  &kp LCTRL  &kp SEMI    &kp Q        &kp J        &kp K         &kp X                         &kp LCTRL
#define LEFT_BOTTOM_0 &mo 2      &kp GRAVE   &kp CAPS     &kp LEFT     &kp RIGHT                                   &kp BSPC   &kp ESC   &kp BSPC

#define RIGHT_TOP_0                                                &mo 3       &kp RBKT  &kp RBRC      &kp RPAR      &kp EQUAL    &kp N0       &kp MINUS
#define RIGHT_UPPER_0                                              &none       &kp F     &kp G         &kp C         &kp R        &kp L        &kp RGUI
#define RIGHT_MIDDLE_0 &emacsMx     &kp RCTRL                      &none       &lt 2 D   &hm RSHIFT H  &hm RCTRL T   &hm RALT N   &hm RGUI S   &kp RALT
#define RIGHT_LOWER_0  &i32                                        &kp B       &kp M     &kp W         &kp V         &kp Z        &kp RCTRL
#define RIGHT_BOTTOM_0 &kp RCTRL    &kp ENTER   &kp SPACE          &kp UP      &kp DOWN  &kp LBKT      &kp RBKT      &mo 2

#define layer0 \
        LEFT_TOP_0     RIGHT_TOP_0 \
        LEFT_UPPER_0   RIGHT_UPPER_0 \
        LEFT_MIDDLE_0  RIGHT_MIDDLE_0 \
        LEFT_LOWER_0   RIGHT_LOWER_0 \
        LEFT_BOTTOM_0  RIGHT_BOTTOM_0

